/*
 * Copyright (c) 2024 Thiago Alves
 *
 * SPDX-License-Identifier: MIT
 */

#include "keypos_def/totem.dtsi"

// Keep the same logical layout used on the Corne, but adapt it to the Totem's
// 38-key physical matrix.
#define LAYER_ADAPTER(                                                    \
    k00, k01, k02, k03, k04, k05,           k06, k07, k08, k09, k0A, k0B, \
    k10, k11, k12, k13, k14, k15, k16, k17, k18, k19, k1A, k1B, k1C, k1D, \
    k20, k21, k22, k23, k24, k25, k26, k27, k28, k29, k2A, k2B, k2C, k2D, \
    k30, k31, k32, k33, k34, k35, k36, k37, k38, k39, k3A, k3B, k3C, k3D, \
         k40, k41, k42, k43, k44, k45, k46, k47, k48, k49, k4A, k4B       \
)                                                                         \
             k11 k12 k13 k14 k15                      k18 k19 k1A k1B k1C \
             k21 k22 k23 k24 k25                      k28 k29 k2A k2B k2C \
        k30 k31 k32 k33 k34 k35                      k38 k39 k3A k3B k3C k3D \
                         k40 k43 k44            k47 k48 k4B

#define COMBO_KEY_CAPS_WORD  <LM1 RM1>

#define USE_HOLD_TAP_LAYER_BUTTONS
#define USE_HOLD_TAP_LAYER_FUNCTIONS
#define USE_HOLD_TAP_LAYER_MOUSE

#define ZMK_MOUSE_DEFAULT_MOVE_VAL 1000
#define ZMK_MOUSE_DEFAULT_SCRL_VAL 35

// The Totem drops the Corne's outer top/home keys. Keep them reachable on
// layers that already fit their category without disturbing the alpha layout.
//
// Extra Totem tweaks for typing/programming:
// - quote moves to SYM + ; (easy apostrophe/double-quote)
// - minus moves to SYM + O (easy minus/underscore)
// - ] moves to SYM + P
#define P_LT4_SYM &kp GRAVE
#define P_LT3_SYM &kp TAB
#define P_RT3_SYM &kp MINUS
#define P_RT4_SYM &kp RBKT
#define P_RM4_SYM &kp SQT
#define P_RT4_SYS &kp MINUS
#define P_RM4_SYS &kp SQT

#include "layout/standard_layout.dtsi"

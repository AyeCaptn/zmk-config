/*
 * Copyright (c) 2024 Thiago Alves
 *
 * SPDX-License-Identifier: MIT
 */

// The dongle acts as the central host for the Totem split keyboard.
// It carries no physical keys, but ZMK requires a zmk,keymap node in order
// to compile keymap.c — and the Prospector layer roller reads display-name
// properties from it to populate the on-screen layer display.
//
// This file is identical to totem.keymap in every way that matters for the
// display: same LAYER_ADAPTER mapping, same feature flags, same shared layout
// include.  The mock kscan in totem_dongle.overlay means no keys will ever
// fire from the dongle itself; all key events arrive via BLE from the halves.

#include "keypos_def/totem.dtsi"

#define LAYER_ADAPTER(                                                    \
    k00, k01, k02, k03, k04, k05,           k06, k07, k08, k09, k0A, k0B, \
    k10, k11, k12, k13, k14, k15, k16, k17, k18, k19, k1A, k1B, k1C, k1D, \
    k20, k21, k22, k23, k24, k25, k26, k27, k28, k29, k2A, k2B, k2C, k2D, \
    k30, k31, k32, k33, k34, k35, k36, k37, k38, k39, k3A, k3B, k3C, k3D, \
         k40, k41, k42, k43, k44, k45, k46, k47, k48, k49, k4A, k4B       \
)                                                                         \
             k11 k12 k13 k14 k15                      k18 k19 k1A k1B k1C \
             k21 k22 k23 k24 k25                      k28 k29 k2A k2B k2C \
        k30 k31 k32 k33 k34 k35                      k38 k39 k3A k3B k3C k3D \
                         k40 k43 k44            k47 k48 k4B

#define COMBO_KEY_CAPS_WORD  <LM1 RM1>

#define USE_HOLD_TAP_LAYER_BUTTONS
#define USE_HOLD_TAP_LAYER_FUNCTIONS
#define USE_HOLD_TAP_LAYER_MOUSE

#define ZMK_MOUSE_DEFAULT_MOVE_VAL 1000
#define ZMK_MOUSE_DEFAULT_SCRL_VAL 35

#define P_LT4_SYM &kp GRAVE
#define P_LT3_SYM &kp TAB
#define P_RT3_SYM &kp MINUS
#define P_RT4_SYM &kp RBKT
#define P_RM4_SYM &kp SQT
#define P_RT4_SYS &kp MINUS
#define P_RM4_SYS &kp SQT

#include "layout/standard_layout.dtsi"
